/**
  ******************************************************************************
  * @file    SK6812.c
  * @author  xie
  * @version V1
  * @date    2021年11月2日
  * @brief   扩展端口模块SK6812单总线三色灯函数库
	
						端口定义：
						PA1:SK6812_IO SK6812单总线引脚
	******************************************************************************
**/	
#include "SK6812.h"
#include "delay.h"
/***************************************************************
函数名：SK6812_Init
功  能：SK6812的IO端口初始化
参  数：无
返回值：无
***************************************************************/
void SK6812_Init(void)
{
	GPIO_InitTypeDef GPIO_Initure;
	__HAL_RCC_GPIOA_CLK_ENABLE();						//开启GPIOA时钟

	GPIO_Initure.Pin=GPIO_PIN_1;           	//PA1
	GPIO_Initure.Mode=GPIO_MODE_OUTPUT_PP;  //推挽输出
	GPIO_Initure.Pull=GPIO_PULLUP;          //上拉
	GPIO_Initure.Speed=GPIO_SPEED_HIGH;     //高速
	HAL_GPIO_Init(GPIOA,&GPIO_Initure);     //初始化
	
	SK6812_Reset();
	
}


/***************************************************************
函数名：SK6812_Delay
功  能：SK6812延时函数
参  数：无
返回值：无
***************************************************************/
void SK6812_Delay(uint8_t nns)
{
	uint8_t i;
	i = nns;
	do
	{
		;
	}while(--i);
}


/***************************************************************
函数名：SK6812_Set_1
功  能：SK6812输出“1码”
参  数：无
返回值：无
注：“1码”的表示方法为850ns±150ns高电平,400ns±150ns低电平
	一定要使用寄存器操作,否则IO速度不够
***************************************************************/
void SK6812_Set_1(void)
{
	SK6812_IO=1;
	SK6812_Delay(25);
	SK6812_IO=0;
	SK6812_Delay(10);
}

/***************************************************************
函数名：SK6812_Set_0
功  能：SK6812输出“0码”
参  数：无
返回值：无
注：“0码”的表示方法为850ns±150ns低电平,400ns±150ns高电平
	一定要使用寄存器操作,否则IO速度不够
***************************************************************/
void SK6812_Set_0(void)
{
	SK6812_IO=1;
	SK6812_Delay(10);
	SK6812_IO=0;
	SK6812_Delay(25);
}

/***************************************************************
函数名：SK6812_Reset
功  能：SK6812复位
参  数：无
返回值：无
***************************************************************/
void SK6812_Reset(void)
{
	SK6812_IO=1;
	delay_us(60);
}
	
void SK6812_Byte(uint8_t WS2812_Data)
{
	for(uint8_t i=0 ;i<8;i++)
	{
		if(WS2812_Data&0x80)
		{
			SK6812_Set_1();
		}
		else
		{
			SK6812_Set_0();
		}
		WS2812_Data<<=1;
	}
}
	
void SK6812_Handle(uint8_t R_Data,uint8_t G_Data,uint8_t B_Data)
{
	SK6812_Reset();
	SK6812_Byte(G_Data);
	SK6812_Byte(R_Data);
	SK6812_Byte(B_Data);
}
///***************************************************************
//函数名：SK6812_Handle
//功  能：控制SK6812产生不同的颜色
//参  数：R8G8B8,从高位到低位按顺序表示：红绿蓝
//返回值：无
//***************************************************************/
//void SK6812_Handle(uint32_t R8G8B8)
//{
//	int8_t   i,tp;
//	uint32_t G8R8B8;
//	
//	G8R8B8 = ((R8G8B8 & 0x00ff00) << 8) + ((R8G8B8 & 0xff0000) >> 8) + (R8G8B8 & 0x0000ff);


//	for(i=23;i>=0;i--)
//	{
//		tp = (G8R8B8 >> i) & 0x01;
//		if(tp == 1)
//		{
//			SK6812_Set_1();
//		}
//		else
//		{
//			SK6812_Set_0();
//		}
//	}
//}

